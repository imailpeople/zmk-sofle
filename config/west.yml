## config/west.yml
```yaml
manifest:
  remotes:
    - name: zmkfirmware
      url-base: https://github.com/zmkfirmware
      # Additional modules containing boards/shields/custom code can be listed here as well.
      # See:
      # - https://zmk.dev/docs/features/modules
      # - https://docs.zephyrproject.org/3.5.0/develop/west/manifest.html#projects
    #- name: gpeye #mario
    #  url-base: https://github.com/GPeye
    - name: urob
      url-base: https://github.com/urob
    - name: m165437 #gem shield
      url-base: https://github.com/M165437
  projects:
    #- name: mario-peripheral-animation
    #  remote: gpeye
    #  revision: main 
    - name: nice-view-gem
      remote: m165437
      revision: main
    - name: zmk
      remote: zmkfirmware
      revision: main
      import: app/west.yml
    - name: zmk-auto-layer
      remote: urob
      revision: main # set to same version as zmk
  self:
    path: boards
```
